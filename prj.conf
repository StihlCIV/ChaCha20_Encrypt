## CMakeLists.txt
```
#
# Copyright (c) 2021 Nordic Semiconductor ASA
#
# SPDX-License-Identifier: LicenseRef-Nordic-5-Clause
#

cmake_minimum_required(VERSION 3.20.0)

find_package(Zephyr REQUIRED HINTS $ENV{ZEPHYR_BASE})

project(chacha_poly)

target_sources(app PRIVATE
        src/main.c
        src/chacha20.c)
```

## prj.conf
```kconfig
# The Zephyr CMSIS emulation assumes that ticks are ms, currently
CONFIG_SYS_CLOCK_TICKS_PER_SEC=1000

CONFIG_MAIN_STACK_SIZE=4096
CONFIG_HEAP_MEM_POOL_SIZE=4096

# Enable loging using RTT and UART
CONFIG_CONSOLE=y
CONFIG_LOG=y
CONFIG_USE_SEGGER_RTT=y
CONFIG_LOG_BACKEND_RTT=y
CONFIG_LOG_BACKEND_UART=y
CONFIG_LOG_BUFFER_SIZE=15360
CONFIG_SEGGER_RTT_BUFFER_SIZE_UP=15360

# Enable nordic security backend and PSA APIs
CONFIG_NRF_SECURITY=y  
CONFIG_MBEDTLS_PSA_CRYPTO_C=y

CONFIG_MBEDTLS_ENABLE_HEAP=y
CONFIG_MBEDTLS_HEAP_SIZE=8192

CONFIG_PSA_WANT_GENERATE_RANDOM=y
CONFIG_PSA_WANT_KEY_TYPE_CHACHA20=y
CONFIG_PSA_WANT_ALG_STREAM_CIPHER=y

# CONFIG_PSA_CRYPTO_DRIVER_OBERON=n
# CONFIG_PSA_CRYPTO_DRIVER_CC3XX=y


# CONFIG_PSA_CRYPTO_DRIVER_OBERON=y
# CONFIG_PSA_CRYPTO_DRIVER_CC3XX=n
# 20 *  encrypting of 2048 bytes : 349 ms for 1000* encryption
# 20 *  decrypting of 2048 bytes : 1011 ms for 1000* decryption

# CONFIG_PSA_CRYPTO_DRIVER_OBERON=n
# CONFIG_PSA_CRYPTO_DRIVER_CC3XX=n
# error

# CONFIG_PSA_CRYPTO_DRIVER_OBERON=n
# CONFIG_PSA_CRYPTO_DRIVER_CC3XX=y
# 20 *  encrypting of 2048 bytes : 455 ms for 1000* encryption
# 20 *  decrypting of 2048 bytes : 1118 ms for 1000* decryption


CONFIG_PSA_CRYPTO_DRIVER_OBERON=y
CONFIG_PSA_CRYPTO_DRIVER_CC3XX=y
# 20 *  encrypting of 2048 bytes : 405 ms for 1000* encryption
# 20 *  decrypting of 2048 bytes : 1068 ms for 1000* decryption
```

## src/main.c
```c
/*
 * Copyright (c) 2019-2022, Arm Limited. All rights reserved.
 *
 * SPDX-License-Identifier: BSD-3-Clause
 *
 */
#include <zephyr/kernel.h>
#include <zephyr/sys/printk.h>
#include <stdio.h>
#include <stdlib.h>
#include <psa/crypto.h>
#include <psa/crypto_extra.h>
#include <zephyr/logging/log.h>
#include <zephyr/random/rand32.h>
#include "chacha20.h"

#ifdef CONFIG_BUILD_WITH_TFM
#include <tfm_ns_interface.h>
#endif


#define APP_SUCCESS (0)
#define APP_ERROR (-1)

#define PRINT_HEX(p_label, p_text, len)                   \
	({                                                    \
		LOG_HEXDUMP_INF(p_text, len, "Content:");         \
	})

LOG_MODULE_REGISTER(chacha20, LOG_LEVEL_DBG);

static uint8_t inData[55] = {0, 1, 2, 3, 4, 5, 6, 7, 8, 9,\
                             10, 11, 12, 13, 14, 15, 16, 17, 18, 19,\
                             20, 21, 22, 23, 24, 25, 26, 27, 28, 29,\
                             30, 31, 32, 33, 34, 35, 36, 37, 38, 39,\
                             40, 41, 42, 43, 44, 45, 46, 47, 48, 49,\
                             50, 51, 52, 53, 54};
static uint8_t outData[55];
static uint8_t decData[55];
/* The initial counter of the Chacha20 RFC7539 test vectors is 1, while the PSA
 * APIs assume it to be zero. This means that this expected ciphertext is not
 * the same as the one presented in the RFC
 */
int crypto_init(void)
{
	psa_status_t status;

	/* Initialize PSA Crypto */
	status = psa_crypto_init();
	if (status != PSA_SUCCESS)
		return APP_ERROR;

	return APP_SUCCESS;
}


/* */
uint32_t time_usi64[4]= {0};

int main(void)
{
	uint32_t tDiffEnc_i64 = 0;
	uint32_t tDiffDec_i64 = 0;
	uint32_t ind = 0;
	uint8_t plainText_bo = 0;
	int status;
    
	// uint8_t newSerNr_aui8[LEN_SERIAL_NO] = {0};
	status = crypto_init();
	if (status != APP_SUCCESS)
	{
		return APP_ERROR;
	}
	
	while(1)
	{
        chacha20Encryption(outData, inData, 55);
		LOG_HEXDUMP_INF(inData, 42, "original data");
		LOG_HEXDUMP_INF(outData, 42, "encrypted data");
		k_sleep(K_MSEC(2000));

        chacha20Encryption(decData, outData, 42);
		LOG_HEXDUMP_INF(decData, 42, "decrypted data");
		k_sleep(K_MSEC(5000));
	}

	return APP_SUCCESS;
}
```

## src/chacha20.c
```c
#include <zephyr/kernel.h>
#include <zephyr/sys/printk.h>
#include <stdio.h>
#include <stdlib.h>
#include <psa/crypto.h>
#include <psa/crypto_extra.h>
#include <zephyr/logging/log.h>
#include <zephyr/random/rand32.h>
#include "chacha20.h"

#define APP_SUCCESS (0)
#define APP_ERROR (-1)

#define LEN_KEY 0x20
#define LEN_NONCE 0x0C

// static const uint8_t wrongKey_aui8[LEN_KEY]  = {0xd3, 0x64, 0x7a, 0x29, 0xde, 0xd3, 0x15, 0x28,
// 												0xef, 0x56, 0xba, 0xc7, 0x0c, 0x0d, 0x0e, 0x0f,
// 												0x10, 0x11, 0x12, 0x13, 0x14, 0x1a, 0x1b, 0x1c,
// 												0x00, 0x00, 0x00, 0x00, 0x09, 0x12, 0x13, 0x13};
static const uint8_t chachaKey_aui8[LEN_KEY] = {0xe3, 0x64, 0x7a, 0x29, 0xde, 0xd3, 0x15, 0x28,
												0xef, 0x56, 0xba, 0xc7, 0x0c, 0x0d, 0x0e, 0x0f,
												0x10, 0x11, 0x12, 0x13, 0x14, 0x1a, 0x1b, 0x1c,
												0x00, 0x00, 0x00, 0x00, 0x09, 0x12, 0x13, 0x13};
static uint8_t chachaNonce_aui8[LEN_NONCE] = {0x43, 0x82, 0xc3, 0x6b, 0x0a, 0x03, 0x00, 0xCF,
											  0xEA, 0x00, 0x00, 0x00};


// static int chacha20Encryption(uint8_t* pDst, uint8_t* pSrc, uint8_t dstLen);

/*
 * srcData: source data to be encrypted.
 * encData: holder to stored encrypted data.
 * len_Dat: length of enc Data.
 */                                           
 int chacha20Encryption(uint8_t *encData, uint8_t *srcData, uint8_t lenEncDataui8)
{
	psa_cipher_operation_t handle = psa_cipher_operation_init();
	psa_cipher_operation_t handle_dec = psa_cipher_operation_init();
	psa_status_t status = PSA_SUCCESS;
	psa_key_handle_t key_handle = 0;
	psa_key_attributes_t key_attributes = psa_key_attributes_init();
	const psa_algorithm_t alg = PSA_ALG_STREAM_CIPHER;
	bool bAbortDecryption = false;

	/* Variables required during multipart update */
	size_t outputLen = 0;
	// int comp_result;
	int ret = APP_ERROR;

	/* Setup the key policy */
	psa_set_key_usage_flags(&key_attributes, PSA_KEY_USAGE_ENCRYPT | PSA_KEY_USAGE_DECRYPT);
	psa_set_key_lifetime(&key_attributes, PSA_KEY_LIFETIME_VOLATILE);
	psa_set_key_algorithm(&key_attributes, PSA_ALG_STREAM_CIPHER);
	psa_set_key_type(&key_attributes, PSA_KEY_TYPE_CHACHA20);
	psa_set_key_bits(&key_attributes, 256);	// 32 bytes key for chacha

	/* Load the predefined Key */
	status = psa_import_key(&key_attributes, chachaKey_aui8, sizeof(chachaKey_aui8), &key_handle);
	
	if (status != PSA_SUCCESS)
	{
		return APP_ERROR;
	}

	/* Setup algorithm  */
	status = psa_cipher_encrypt_setup(&handle, key_handle, alg);
	if (status != PSA_SUCCESS)
	{
		goto destroy_key;
	}

	/* Set initial vector */
	status = psa_cipher_set_iv(&handle, chachaNonce_aui8, sizeof(chachaNonce_aui8));
	if (status != PSA_SUCCESS)
	{
		goto abort;
	}

	/* Encrypt one chunk of information */
	status = psa_cipher_update(&handle, srcData, lenEncDataui8, encData, 
								lenEncDataui8, &outputLen);
                                
	if ((status != PSA_SUCCESS) || (outputLen != lenEncDataui8))
	{
		goto abort;
	}

	/* Finalise the cipher operation */
	status = psa_cipher_finish(&handle, &encData, 0 , &outputLen);

	if ((status != PSA_SUCCESS) || (outputLen != 0))
	{
		goto abort;
	}
    
	ret = APP_SUCCESS;

	/* Go directly to the destroy_key label at this point */
	goto destroy_key;

abort:
	/* Abort the operation */
	status = bAbortDecryption ? psa_cipher_abort(&handle_dec) : psa_cipher_abort(&handle);
	if (status != PSA_SUCCESS)
	{
		ret = APP_ERROR;
	}
destroy_key:
	/* Destroy the key */
	status = psa_destroy_key(key_handle);
	if (status != PSA_SUCCESS)
	{
		ret = APP_ERROR;
	}

	return ret;
}


/*
 *	pSerNo_ui8: serial number, 6 bytes
 *	pEndData_ui8: 6 + 2 + 3 = 11 bytes
 */

/*
 * TxData = Payload + 3 bytes nonce + 4 bytes  CRC
 */
int encryptAdvertising(struct stihlAdvData_st* pDst_st, struct stihlAdvData_st* pSrc_st)
{
    int status = -1;
	
	/* Step 1: Add CRC32 of service data to payload. */
	pSrc_st->plainText_st.crc16_ui16 = crc16_ccitt(0x0000, pSrc_st->plainText_st.servData_aui8, LEN_SERVDATA);
    // pSrc_st->plainText_st.crc32_ui32 = crc32_ieee(pSrc_st->plainText_st.servData_aui8, LEN_SERVDATA);
    
	// printk("\ncrc_org: %x", pSrc_st->plainText_st.crc32_ui32 );

	/* Step 2: Create 3 bytes random nonce and add it to nounce. */
	/* sys_rand_get needs crapto engin. */
	sys_rand_get(pSrc_st->randomNonce_aui8, LEN_RANDOM);
	memcpy(pDst_st->randomNonce_aui8, pSrc_st->randomNonce_aui8, LEN_RANDOM);
	memcpy(&chachaNonce_aui8[LEN_NONCE - LEN_RANDOM], pDst_st->randomNonce_aui8, LEN_RANDOM);

	// printk("\nrnadom_org: %x, %x, %x", pDst_st->randomNonce_aui8[0], pDst_st->randomNonce_aui8[1], pDst_st->randomNonce_aui8[2]);
	
	/* Step 3: encrypt data */
	// status = chacha20Encryption(&(pDst_st->plainText_st), &(pSrc_st->plainText_st), LEN_PAYLOAD);
	return status;
}


/*
 * descrypting advertising
 */
int decryptAdvertising(struct payLoad_st* pDecPayLoad_st, struct stihlAdvData_st* pEncAdvData_st, uint8_t lenPayload_ui8)
{
    int status = PSA_SUCCESS;
	// uint32_t newCrc32_ui32 = 0xFFFFFFFF;
	uint16_t newCrc16_ui16 = 0xFFFF;

	/* Step 1: Get 3 bytes nonce from encData */
	memcpy(&chachaNonce_aui8[LEN_NONCE - LEN_RANDOM], pEncAdvData_st->randomNonce_aui8, LEN_RANDOM);

	/* Step 2: Decrypt data */	
	status = chacha20Encryption(pDecPayLoad_st, &(pEncAdvData_st->plainText_st), LEN_PAYLOAD);

	/* Step 3: Calculate CRC32 */
	newCrc16_ui16 = crc16_ccitt(0x0000, pDecPayLoad_st->servData_aui8, LEN_SERVDATA);

	if((newCrc16_ui16 != pDecPayLoad_st->crc16_ui16) ||
	   ((uint8_t) LEN_SERVDATA != pDecPayLoad_st->lenSD_ui8 ))
	{
		status = PSA_ERROR_GENERIC_ERROR;
	}

	return status;
}
```

## src/chacha20.h
```c
#ifndef __CHACHA20_H
#define __CHACHA20_H

#define PROTOCOL_ID 0x06
#define MODEL_ID 	0x0005

 
#define LEN_PROTOCOL_ID	0x00
#define LEN_MODEL_ID	0x00
/* not required, but better if length of payload + CRC can be divided by 16. */
#define LEN_LENSD 		1
#define LEN_SERVDATA 	14	//85, 53 or 21
#define LEN_CRC 		2
#define LEN_RANDOM 		3
#define LEN_PAYLOAD     (LEN_LENSD + LEN_SERVDATA + LEN_CRC )
#define LEN_ADVERTISING (LEN_PROTOCOL_ID + LEN_MODEL_ID + LEN_PAYLOAD + LEN_RANDOM)

/* Structure of payload */
struct  __attribute__((packed)) payLoad_st
{
	uint8_t lenSD_ui8;
	uint8_t servData_aui8[LEN_SERVDATA];
	// uint32_t crc32_ui32;
	uint16_t crc16_ui16;
};

/* structrue of advertising */
struct  __attribute__((packed)) stihlAdvData_st
{
	// uint8_t protocolID_ui8;
	// uint16_t modelID_ui16;
	struct payLoad_st plainText_st;
	uint8_t randomNonce_aui8[LEN_RANDOM];
};

extern int encryptAdvertising(struct stihlAdvData_st* pDst_st, struct stihlAdvData_st* pSrc_st);

extern int decryptAdvertising(struct payLoad_st* pDecPayLoad_st, struct stihlAdvData_st* pEncAdvData_st, uint8_t lenPayload_ui8);
extern  int chacha20Encryption(uint8_t* pDst, uint8_t* pSrc, uint8_t dstLen);
#endif
```
